## CMakeLists.txt
```
#
# Copyright (c) 2020 Nordic Semiconductor
#
# SPDX-License-Identifier: LicenseRef-BSD-5-Clause-Nordic
#
cmake_minimum_required(VERSION 3.8.2)

find_package(Zephyr REQUIRED HINTS $ENV{ZEPHYR_BASE})
project(tracker_dfu)

zephyr_include_directories(src)

target_sources(app PRIVATE src/main.c)
target_sources(app PRIVATE src/app_uart.c)
target_sources(app PRIVATE src/app_cmd.c)
target_sources(app PRIVATE src/app_flash.c)
target_sources(app PRIVATE src/app_flash_cmd.c)
target_sources(app PRIVATE src/button.c)
target_sources(app PRIVATE src/led.c)
target_sources(app PRIVATE src/http_client.c)

# Add serial dfu module
zephyr_include_directories(src/serial_dfu)
target_sources(app PRIVATE src/serial_dfu/serial_dfu.c)
target_sources(app PRIVATE src/serial_dfu/dfu_drv.c)
target_sources(app PRIVATE src/serial_dfu/dfu_file.c)
target_sources(app PRIVATE src/serial_dfu/dfu_host.c)
target_sources(app PRIVATE src/serial_dfu/slip.c)
target_sources(app PRIVATE src/serial_dfu/crc32.c)
```

## prj.conf
```kconfig
#
# Copyright (c) 2019 Nordic Semiconductor ASA
#
# SPDX-License-Identifier: LicenseRef-BSD-5-Clause-Nordic
#


### Enable debug optimization
# CONFIG_NO_OPTIMIZATIONS=y         # This option will make NBIOT **CRASH**
CONFIG_DEBUG_OPTIMIZATIONS=y

### Enable LOG, LOG_MINIMAL and ASSERT
CONFIG_NCS_SAMPLES_DEFAULTS=y

### Enable LOG prefix
# CONFIG_LOG_MINIMAL=n

### Enable reboot
CONFIG_REBOOT=y # Enable sys_reboot()

### Disable printing boot banner
CONFIG_BOOT_BANNER=n

### Enable k_malloc/k_free
CONFIG_HEAP_MEM_POOL_SIZE=2048
CONFIG_MAIN_STACK_SIZE=8192

### Enabel Flash library
CONFIG_FLASH=y
CONFIG_IMG_MANAGER=y
CONFIG_IMG_ERASE_PROGRESSIVELY=y
CONFIG_MPU_ALLOW_FLASH_WRITE=y		# Necessary for flash map write/erase operation

### Peripheral-GPIO
CONFIG_GPIO=y

### Peripheral-UART
CONFIG_UART_INTERRUPT_DRIVEN=y

### BSD
CONFIG_BSD_LIBRARY=y
CONFIG_BSD_LIBRARY_SYS_INIT=n
CONFIG_TRUSTED_EXECUTION_NONSECURE=y

### Network
CONFIG_NETWORKING=y
CONFIG_NET_SOCKETS=y
CONFIG_NET_NATIVE=n

### LTE
CONFIG_LTE_LINK_CONTROL=y
CONFIG_LTE_AUTO_INIT_AND_CONNECT=n

### NBIOT
CONFIG_LTE_NETWORK_MODE_NBIOT=y
CONFIG_LTE_LEGACY_PCO_MODE=y

### Download client
CONFIG_DOWNLOAD_CLIENT=y
CONFIG_DOWNLOAD_CLIENT_TLS=y
CONFIG_DOWNLOAD_CLIENT_STACK_SIZE=4096

### MCUBoot and DFU
CONFIG_BOOTLOADER_MCUBOOT=y
CONFIG_DFU_TARGET=y
CONFIG_FOTA_DOWNLOAD=y

### Modem info library (modem firmware version)
CONFIG_MODEM_INFO=y
CONFIG_MODEM_INFO_ADD_DEVICE=y
CONFIG_MODEM_INFO_ADD_NETWORK=n
CONFIG_MODEM_INFO_ADD_SIM=n
CONFIG_MODEM_INFO_ADD_SIM_ICCID=n
CONFIG_MODEM_INFO_ADD_SIM_IMSI=n
CONFIG_MODEM_INFO_ADD_BOARD=n
```

## nrf9160dk_nrf9160ns.overlay
```dts
&uart3 {
	status = "okay";
	current-speed = <115200>;
	tx-pin = <18>;
	rx-pin = <17>;
};
```

## src/main.c
```c
#include <string.h>
#include <zephyr.h>
#include <net/fota_download.h>
#include <power/reboot.h>
#include <sys/byteorder.h>
#include <dfu/dfu_target.h>
#include <dfu/mcuboot.h>
#include <modem/modem_info.h>
#include <logging/log.h>
LOG_MODULE_REGISTER(main, 3);


#include "button.h"
#include "led.h"
#include "http_client.h"
#include "app_flash.h"
#include "app_cmd.h"
#include "app_flash_cmd.h"
#include "serial_dfu/serial_dfu.h"
#include "serial_dfu/dfu_host.h"
#include "serial_dfu/dfu_file.h"

#define UPDATE_APP 					false

#define IMAGE_FROM_HTTP				1
#define IMAGE_FROM_SERIAL			2

#define UART_DEVICE_LABLE 			"UART_3"

#define CMD_OP_ENTER_BL				0x31
#define CMD_OP_PING_APP				0x32

#define ENTER_BL_DELAY				1000000			/* 1 second */
#define MODEM_DATA_UNIT_LEN			256

static struct device*				m_uart_dev;

static char* m_http_host = "106.13.189.165";
static char* m_http_file_52 = "dfu_file_52";
static char* m_http_file_91 = "dfu_file_91";

static bool 	m_download_busy;
static uint8_t  m_image_channel;
static uint8_t  m_image_file_type;
static uint32_t m_image_file_size;

static struct k_work wk_serial_dfu;               /* k_work to perform DFU */
static struct k_work wk_update_mcuboot_flag;

static char m_modem_version[MODEM_INFO_MAX_RESPONSE_SIZE];

/**@brief copy image to modem core */
static void copy_image_to_modem(void)
{
	int rc;

	uint8_t p_data[MODEM_DATA_UNIT_LEN];
	uint32_t len = 0;
	uint32_t offset = 0;

	while (true) {
		if (offset == m_image_file_size) {
			break;
		}

		if (offset + MODEM_DATA_UNIT_LEN <= m_image_file_size) {
			len = MODEM_DATA_UNIT_LEN;
		}
		else {
			len = m_image_file_size - offset;
		}

		rc = app_flash_read(offset, p_data, len);
		if (rc != 0) {
			LOG_ERR("Read for modem error: %d", rc);
		}

		rc = dfu_target_write(p_data, len);
		if (rc != 0) {
			LOG_ERR("Write for modem error: %d", rc);
		}

		offset += len;
	}

}

/**@brief Start to download a file */
static void http_download_start(char* file_path)
{
	m_image_channel = IMAGE_FROM_HTTP;
	m_download_busy = true;

	http_client_download(m_http_host, file_path);
}

/**@brief Do serial dfu for 52 */
static void do_serial_dfu(void)
{
	int rc;
	bool bl_mode;

	// Uninit app_cmd as it's use the same UART 
	// component as serial DFU
	app_cmd_uninit();

	rc = serial_dfu_init(m_uart_dev);
	if (rc) {
		LOG_ERR("Serial DFD init failed");
		return;
	}

	bl_mode = dfu_host_bl_mode_check();

	if (bl_mode) {
		LOG_INF("Found bootloader, start DFU");
		serial_dfu_start();
	}
	else {
		LOG_WRN("No bootloader, quit");
	}

	// Give back UART component
	serial_dfu_uninit();
	app_cmd_init(m_uart_dev);
}

/**@brief Do mcuboot dfu for 91 */
static void do_mcuboot_dfu(void)
{
	LOG_INF("Start to reboot...");

	sys_reboot(SYS_REBOOT_WARM);
}

/**@brief Callback of k_work to perform DFU */
static void wk_serial_dfu_handler(struct k_work* unused)
{
	do_serial_dfu();
}

/**@brief A dummy callback function */
void dfu_target_cb_dummy(enum dfu_target_evt_id evt_id) {;}

/**@brief k_work handler for updating mcuboot flag */
static void wk_update_mcuboot_flag_handler(struct k_work* unused)
{
	if (m_image_file_type == IMAGE_TYPE_NRF52) {
		app_flash_erase_from_end(1);
	}
	else if (m_image_file_type == IMAGE_TYPE_NRF91) {
		dfu_target_init(DFU_TARGET_IMAGE_TYPE_MCUBOOT, 0, dfu_target_cb_dummy);	
		dfu_target_done(true);			
	}
	else if (m_image_file_type == IMAGE_TYPE_MODEM) {
		if (m_image_file_size == 0) {
			LOG_ERR("Inavlid image file size");
			return;
		}

		dfu_target_init(DFU_TARGET_IMAGE_TYPE_MODEM_DELTA, 0, dfu_target_cb_dummy);	
	
		LOG_INF("Start to copy image file to modem space");
		copy_image_to_modem();

		dfu_target_done(true);	
	}
	else {
		LOG_ERR("Inavlid image file type");
	}
}

/**@brief Start to run DFU to 91 or 52 due to image type */
static void perform_dfu(void)
{
	int img_type;

	img_type = dfu_file_type();

	if (img_type == IMAGE_TYPE_NRF52) {
		// Check nRF52 in application mode or not
		app_cmd_request(CMD_OP_PING_APP, NULL, 0);
	}
	else {
		do_mcuboot_dfu();
	}
}

/**@brief Handler for button 1 is pressed */
void button1_pressed_handler(void)
{
	if (m_download_busy) {
		return;
	}

	// Turn off LED 2
	led2_set(0);

	// Flip both switches to **RIGHT** to download 91 image
	if ((button_read("switch_1") == 0) &&
		(button_read("switch_2") == 0)) {
		LOG_INF("Download 91 image file...");

		http_download_start(m_http_file_91);
	}
	// Flip both switches to **LEFT** to download 52 image
	else if ((button_read("switch_1") == 1) &&
		(button_read("switch_2") == 1)) {
		LOG_INF("Download 52 image file...");

		http_download_start(m_http_file_52);
	}
	else {
		LOG_INF("Download nothing");
	}
}

/**@brief Handler for button 2 is pressed */
void button2_pressed_handler(void)
{
	perform_dfu();
}

/**@brief Callback for enter_bootloader response. */
static void rsp_cb_enter_bl(u8_t* p_rsp, u16_t rsp_len)
{
	u8_t p_data[] = CMD_RSP_TIMEOUT;
	// Response is timeout, should not come here.
	// If come here, suppose 52 is in bootloader mode.
	if (memcmp(p_rsp, p_data, sizeof(p_data)) == 0) {
		LOG_ERR("cmd timeout: enter_bl");
	}
	// 52 is going to jump to bootloader mode,
	// this delay should be the same as 52 chip
	else {
		k_busy_wait(ENTER_BL_DELAY);
	}

	k_work_submit(&wk_serial_dfu);
}

/**@brief Callback for ping_app response. */
static void rsp_cb_ping_app(u8_t* p_rsp, u16_t rsp_len)
{
	u8_t p_data[] = CMD_RSP_TIMEOUT;
	// Response is timeout, which means 52 chip is 
	// in bootloader mode
	if (memcmp(p_rsp, p_data, sizeof(p_data)) == 0) {
		do_serial_dfu();
	}
	// Got response
	else {
		// If 52 chip is in application mode, 
		// drive it to bootloader mode
		app_cmd_request(CMD_OP_ENTER_BL, NULL, 0);
	}
}

/**@brief Handler for DFU file is downloaded or received */
static void dfu_file_ready(void)
{
	int img_type;

	img_type = dfu_file_type();

	if (img_type < 0) {
		LOG_ERR("DFU file is invalid, %d", img_type);
		return;
	}

	led2_set(1);

	/* If fetching image from http, fota_download library will
	 * take it as a mcuboot image, and adds a flag at the end of
	 * secondary bank, we need to remove it for 52 image to stop
	 * mcuboot behavior after reboot.
	 * If fetching image by UART fromrnrf52, we need to add a 
	 * mcuboot flag manually to make it a valid mcuboot image.
	 */
	if (m_image_channel == IMAGE_FROM_HTTP) {
		if (img_type == IMAGE_TYPE_NRF52) {
			// Remove the last page of secondary bank
			LOG_INF("Remove MCUboot flag for 52 image");

			m_image_file_type = IMAGE_TYPE_NRF52;

			k_work_submit(&wk_update_mcuboot_flag);
		}
		else {
			LOG_INF("Press button 2 to do DFU");
		}		
	}
	else if (m_image_channel == IMAGE_FROM_SERIAL) {
		if (img_type == IMAGE_TYPE_NRF91) {
			// Add mcuboot meta info
			LOG_INF("Add MCUboot flag for 91 application");

			m_image_file_type = IMAGE_TYPE_NRF91;

			k_work_submit(&wk_update_mcuboot_flag);
		}
		else if (img_type == IMAGE_TYPE_MODEM) {
			// Add mcuboot meta info
			LOG_INF("Add MCUboot flag for 91 modem");
			m_image_file_type = IMAGE_TYPE_MODEM;

			k_work_submit(&wk_update_mcuboot_flag);
		}

		LOG_INF("Press button 2 to do DFU");
	}
	else {
		// Should not come here
		LOG_ERR("Invalid image channel");
	}
}

/**@brief FOTA download event handler */
static void download_event_handler(const struct fota_download_evt* evt)
{
	switch (evt->id) {
	case FOTA_DOWNLOAD_EVT_FINISHED:
		LOG_INF("FOTA download finished");
		m_download_busy = false;
		dfu_file_ready();
		break;

	case FOTA_DOWNLOAD_EVT_ERROR:
		LOG_ERR("FOTA download error");
		m_download_busy = false;
		break;

	default:
		break;
	}
}

/**@brief Get modem version
 * @param[out] version of modem in string format
 * 
 * @return 0: success
 * 		 neg: failed
 */
static int modem_version_get(char* version_string)
{
	int rc;
	struct modem_param_info modem_info = {0};

	rc = modem_info_init();
	if (rc) {
		LOG_ERR("Could not initialize modem info module");
		return rc;
	}

	rc = modem_info_params_init(&modem_info);
	if (rc) {
		LOG_ERR("Could not initialize modem info parameters");
		return rc;
	}

	rc = modem_info_params_get(&modem_info);
	if (rc) {
		LOG_ERR("Could not obtain cell information");
		return rc;
	}

	strcpy(version_string, modem_info.device.modem_fw.value_string);

	return rc;
}

/**@brief app_cmd request & response event handler.
 *		 Note, don't run long-time task here. 
 */
static void app_cmd_event_handler(cmd_event_t* p_event)
{
	static u32_t start_time;
	u32_t total_time;
	u32_t speed_integer;
	u32_t speed_fraction;

	switch (p_event->op_code) {
	case CMD_OP_FLASH_INFO:
		LOG_INF("Start to receive DFU image by UART");
		start_time = k_uptime_get_32();

		break;

	case CMD_OP_FLASH_DONE:
		LOG_INF("DFU image is received by UART");
		m_image_file_size = sys_get_le32(p_event->p_data);
		LOG_INF("File size is: %d", m_image_file_size);	

		total_time = k_uptime_get_32() - start_time;
		speed_integer = m_image_file_size / total_time;
		speed_fraction = (m_image_file_size % total_time) * 100 / total_time;

		LOG_INF("UART transferring speed: %d.%d kB/s", speed_integer, speed_fraction);

		m_image_channel = IMAGE_FROM_SERIAL;
		dfu_file_ready();
		break;

	default:
		LOG_DBG("cmd op: 0x%02x", p_event->op_code);
		break;
	}
}

void main(void)
{
	int rc = 0;

#if UPDATE_APP
	LOG_INF("Cross DFU Demo(new)\n");
#else 
	LOG_INF("Cross DFU Demo(ori)\n");
#endif

	led_init();

#if UPDATE_APP
	led3_set(1);
	led4_set(1);
#endif

	rc = button_init();
	if (rc) {
		goto err;
	}
	button_handler_assign("button_1", button1_pressed_handler);
	button_handler_assign("button_2", button2_pressed_handler);

	rc = http_client_init(download_event_handler);
	if (rc) {
		LOG_ERR("HTTP Client init error.");
		goto err;
	}

	modem_version_get(m_modem_version);
	LOG_INF("modem version: %s", m_modem_version);

	LOG_INF("Connecting NBIOT...(don't run other tasks now)");
	rc = http_client_connect();
	if (rc) {
		LOG_ERR("Can't connect to NBIOT");
		goto err;
	}
	LOG_INF("NBIOT network is connected.");	

	// After NBIOT connection, LED 1 is on
	led1_set(1);	

	LOG_INF("Put switchs left:  download 52 DFU file");
	LOG_INF("Put switchs right: download 91 DFU file");

	k_work_init(&wk_serial_dfu, wk_serial_dfu_handler);
	k_work_init(&wk_update_mcuboot_flag, wk_update_mcuboot_flag_handler);

	m_uart_dev = device_get_binding(UART_DEVICE_LABLE);
	if (m_uart_dev == NULL) {
		LOG_ERR("Can't init UART component");
		goto err;
	}

	app_cmd_init(m_uart_dev);
	app_cmd_event_cb_register(app_cmd_event_handler);
	app_flash_cmd_init();
	
	// Add cmds
	app_cmd_add(CMD_OP_ENTER_BL, NULL, rsp_cb_enter_bl);
	app_cmd_add(CMD_OP_PING_APP, NULL, rsp_cb_ping_app);

	/* All initializations were successful mark image as working so that we
	 * will not revert upon reboot.
	 */
	boot_write_img_confirmed();

err:
	while (true) {
		k_sleep(K_SECONDS(1));
	}
}
```

## src/app_cmd.c
```c
#include <string.h>
#include <zephyr.h>
#include <device.h>
#include <sys/byteorder.h>
#include <sys/crc.h>
#include <logging/log.h>
LOG_MODULE_REGISTER(cmd, 3);

#include "app_cmd.h"
#include "app_uart.h"

#define SKIP_CRC_CHECK                  false            /* Switch option to skip CRC check or not */

#define CMD_PACKET_LENGTH               1040
#define CMD_POOL_DEPTH                  2
#define CMD_CB_LIST_LEN                 20

#define crc16_compute(p_data, len)      crc16_itu_t(0x0, p_data, len)
#define uint16_decode(p_data)           sys_get_le16(p_data)
#define uint16_encode(value, p_data)    sys_put_le16(value, p_data)

/* Time between requset sent to response received is:
 * slave process request, slave send response data.
 * Host must set a long enough time to wait it, and
 * there should be a timer refresh feature, to avoid
 * timeout is triggered during UART is in active.
 *
 * Note, this value can't be small, some activities such 
 * as flash erase will cost several seconds
 */
#define WAIT_RSP_TIMEOUT                K_MSEC(10000)

 /* string names of each cmd state */
const static char* cmd_state_str[] = {
    "idle", "req_sending", "req_sent",
    "req_receiving", "req_received",
    "rsp_sending", "rsp_sent",
    "rsp_receiving", "rsp_received",
    "err_timeout", "err_sending",
    "err_receiving",
};

const static char* cmd_mode_str[] = {
    "idle", "host", "slave"
};

typedef struct
{
    uint8_t*   p_data;                 /* Pointer of data */
    uint16_t   length;                 /* Data length of the buffer */
    uint16_t   offset;                 /* Datat offset of the buffer */
} buffer_t;

static uint8_t          m_rx_pool[CMD_PACKET_LENGTH];
static uint8_t          m_tx_pool[CMD_PACKET_LENGTH];

static cmd_context_t    m_cmd_ctx;

static buffer_t         m_rx_buff;
static buffer_t         m_tx_buff;

static cmd_event_cb_t   m_event_cb;

static struct k_work    wk_proc_req;               /* A k_work to process request */
static struct k_work    wk_proc_rsp;               /* A k_work to process response */

static cmd_cb_t m_cb_list[CMD_CB_LIST_LEN];    /* User cmd list */

/* Function declaration */
static int req_cb_ping(uint8_t* p_req, uint16_t req_len, cmd_respond_t respond);
static void rsp_cb_ping(uint8_t* p_rsp, uint16_t rsp_len);
static void rsp_cb_raw_data(uint8_t* p_rsp, uint16_t rsp_len);
static int req_cb_raw_data(uint8_t* p_req, uint16_t req_len, cmd_respond_t respond);
static void state_handler(cmd_context_t* p_cmd_ctx);
static int buff_to_cmd(buffer_t* p_buff, app_cmd_t* p_cmd);
static int app_cmd_respond(uint8_t* p_data, uint16_t length);
static void tmr_rsp_timeout_handler(struct k_timer* timer);

/* Timer for waiting response */
K_TIMER_DEFINE(tmr_wait_rsp, tmr_rsp_timeout_handler, NULL);


/**@brief Dummy function of cmd event callback */
static void event_cb_dummy(cmd_event_t* p_event) {;}

/**@brief Check the crc of data sequence with a target crc
 *
 * @param[in] p_data: pointer of the data
 * @param[in] length: data length
 * @param[in] crc_target: target crc
 *
 * @return true: crc matches
 *         false: crc doesn't match
 */
static bool crc16_check(uint8_t* p_data, uint16_t length, uint16_t crc_target)
{
#ifdef SKIP_CRC_CHECK
    if (SKIP_CRC_CHECK) {
        return true;
    }
#endif

    return crc16_compute(p_data, length) == crc_target;
}

/**@brief Allocate a buffer from the pool
 *
 * @note There may be better solution
 *
 * @param[in] p_pool: pointer of data pool
 * @param[in] p_buff: pointer of buffer
 */
static void buff_alloc(uint8_t* p_pool, buffer_t* p_buff)
{
    __ASSERT_NO_MSG(p_pool != NULL);
    __ASSERT_NO_MSG(p_buff != NULL);

    p_buff->p_data = p_pool;
    p_buff->length = 0;
    p_buff->offset = 0;
}

/**@brief Set cmd state */
static void state_set(cmd_context_t* p_cmd_ctx, cmd_state_t new_state)
{
    cmd_state_t old_state = p_cmd_ctx->state;

    if (old_state != new_state) {
        p_cmd_ctx->state = new_state;

        // Always don't enable this print because it may cause 
        // UART data loss when receiving
        LOG_DBG("State: %s -> %s",      \
            cmd_state_str[old_state],   \
            cmd_state_str[new_state]);

        state_handler(p_cmd_ctx);
    }
}

/**@brief Set a new cmd mode */
static void mode_set(cmd_context_t* p_cmd_ctx, cmd_mode_t new_mode)
{
    cmd_mode_t old_mode = p_cmd_ctx->mode;
    if (old_mode != new_mode) {
        p_cmd_ctx->mode = new_mode;

        // Always don't enable this print because it may cause 
        // UART data loss when receiving
        LOG_DBG("Mode: %s -> %s", \
            cmd_mode_str[old_mode], \
            cmd_mode_str[new_mode]);
    }
}

/**@brief Get current cmd mode */
static cmd_mode_t mode_get(cmd_context_t* p_cmd_ctx)
{
    return p_cmd_ctx->mode;
}

/**@brief Get current cmd state */
static cmd_state_t state_get(cmd_context_t* p_cmd_ctx)
{
    return p_cmd_ctx->state;
}

/**@brief State change handler */
static void state_handler(cmd_context_t* p_cmd_ctx)
{
    cmd_state_t state = p_cmd_ctx->state;

    switch (state) {

    case CMD_STATE_IDLE:
        app_uart_rx_reset();
        mode_set(p_cmd_ctx, CMD_MODE_IDLE);
        LOG_DBG("---------\n");
        break;

    case CMD_STATE_REQ_SENDING:
        mode_set(p_cmd_ctx, CMD_MODE_HOST);
        break;

    case CMD_STATE_REQ_SENT:
        /* Issue an one shot timer */
        k_timer_start(&tmr_wait_rsp, WAIT_RSP_TIMEOUT, K_NO_WAIT);
        break;

    case CMD_STATE_RSP_RECEIVING:
        /* TODO: Refresh timer count, to avoid
         * timeout during UART receiving. Now I 
         * set a very long timeout value so it's 
         * safe. */
        break;

    case CMD_STATE_RSP_RECEIVED:
        k_timer_stop(&tmr_wait_rsp);
        k_work_submit(&wk_proc_rsp);
        break;

    case CMD_STATE_REQ_RECEIVING:
        mode_set(p_cmd_ctx, CMD_MODE_SLAVE);
        break;

    case CMD_STATE_REQ_RECEIVED:
        k_work_submit(&wk_proc_req);
        break;

    case CMD_STATE_ERR_TIMEOUT:
        state_set(p_cmd_ctx, CMD_STATE_IDLE);
        break;

    case CMD_STATE_ERR_RECEIVE:
        if (mode_get(&m_cmd_ctx) != CMD_MODE_HOST) {
            state_set(p_cmd_ctx, CMD_STATE_IDLE);
        }
        break;

    case CMD_STATE_RSP_SENT:
    case CMD_STATE_ERR_SEND:
        state_set(p_cmd_ctx, CMD_STATE_IDLE);
        break;

    case CMD_STATE_RSP_SENDING:
    default:
        /* Do nothing */
        break;
    }
}

/**@brief Handler for sending cmd start */
static void on_cmd_send_start(void)
{
    LOG_DBG("%s", __func__);

    if (mode_get(&m_cmd_ctx) == CMD_MODE_SLAVE) {
        state_set(&m_cmd_ctx, CMD_STATE_RSP_SENDING);
    }
    else {
        state_set(&m_cmd_ctx, CMD_STATE_REQ_SENDING);
    }
}

/**@brief Handler for sending cmd complete */
static void on_cmd_send_complete(void)
{
    LOG_DBG("%s", __func__);

    if (mode_get(&m_cmd_ctx) == CMD_MODE_HOST) {
        state_set(&m_cmd_ctx, CMD_STATE_REQ_SENT);
    }
    else if (mode_get(&m_cmd_ctx) == CMD_MODE_SLAVE) {
        state_set(&m_cmd_ctx, CMD_STATE_RSP_SENT);
    }
    else {
        LOG_ERR("Should not come here");
    }
}

/**@brief Handler for sending cmd error */
static void on_cmd_send_error(void)
{
    LOG_ERR("%s", __func__);

    state_set(&m_cmd_ctx, CMD_STATE_ERR_SEND);
}

/**@brief Handler for receiving cmd start */
static void on_cmd_receive_start(void)
{
    LOG_DBG("%s", __func__);

    if (mode_get(&m_cmd_ctx) == CMD_MODE_HOST) {
        state_set(&m_cmd_ctx, CMD_STATE_RSP_RECEIVING);
    }
    else {
        state_set(&m_cmd_ctx, CMD_STATE_REQ_RECEIVING);
    }
}

/**@brief Handler for receiving cmd complete */
static void on_cmd_receive_complete(void)
{
    LOG_DBG("%s", __func__);

    if (mode_get(&m_cmd_ctx) == CMD_MODE_HOST) {
        state_set(&m_cmd_ctx, CMD_STATE_RSP_RECEIVED);
    }
    else if (mode_get(&m_cmd_ctx) == CMD_MODE_SLAVE) {
        state_set(&m_cmd_ctx, CMD_STATE_REQ_RECEIVED);
    }
    else {
        LOG_WRN("Should not come here");
    }
}

/**@brief Handler for receiving cmd error */
static void on_cmd_receive_error(void)
{
    LOG_ERR("%s", __func__);

    state_set(&m_cmd_ctx, CMD_STATE_ERR_RECEIVE);
}

/**@brief Get element count of cmd list */
int cmd_cb_cnt(void)
{
    for (int i = 0; i < CMD_CB_LIST_LEN; i++) {
        if (m_cb_list[i].op_code == 0) {
            return i;
        }
    }

    return CMD_CB_LIST_LEN;
}

/**@brief Get element of cmd list by op code 
 *
 * @param[in] op_code: op code of cmd
 * @param[out] p_cmd_cb: pointer of cmd callback, it can be NULL
 *
 * @return -1: not found
 *         others(>=0): index of the cmd callback
 */
static int cmd_cb_get(uint8_t op_code, cmd_cb_t* p_cmd_cb)
{
    int rc;
    int count;

    rc = -1;
    count = cmd_cb_cnt();

    for (int i = 0; i < count; i++) {
        if (m_cb_list[i].op_code == op_code) {
            if (p_cmd_cb != NULL) {
                p_cmd_cb->proc_req = m_cb_list[i].proc_req;
                p_cmd_cb->proc_rsp = m_cb_list[i].proc_rsp;
            }

            rc = 0;
            break;
        }
    }

    return rc;
}

/**@brief Add a cmd to the list
 *
 * @param[in] op_code: op code of cmd
 * @param[in] req_cb: request callback function
 * @param[in] rsp_cb: response callback function
 *
 * @return 0: success
 * @return -1: cmd list is full
 * @return -2: op code is existed
 */
int app_cmd_add(uint8_t op_code, req_cb_t req_cb, rsp_cb_t rsp_cb)
{
    cmd_cb_t callback;
    int count;

    count = cmd_cb_cnt();
    if (count == CMD_CB_LIST_LEN) {
        LOG_ERR("Cmd list is full");
        return -1;
    }

    if (cmd_cb_get(op_code, NULL) == 0) {
        LOG_WRN("This op code is existed");
        return -2;
    }

    memset(&callback, 0, sizeof(cmd_cb_t));
    callback.op_code = op_code;
    callback.proc_req = req_cb;
    callback.proc_rsp = rsp_cb;

    memcpy(&m_cb_list[count], &callback, sizeof(cmd_cb_t));

    return 0;
}

/**@brief Handler for waiting response timeout */
static void tmr_rsp_timeout_handler(struct k_timer* timer)
{
    LOG_DBG("%s", __func__);

    uint32_t  err_code;
    app_cmd_t cmd;
    cmd_cb_t  cmd_cb;
    cmd_event_t event;

    err_code = buff_to_cmd(&m_tx_buff, &cmd);
    if (err_code != 0) {
        LOG_ERR("Buffer error");
        return;
    }

    err_code = cmd_cb_get(cmd.op_code, &cmd_cb);
    if (err_code == 0) {
        uint8_t p_rsp[] = CMD_RSP_TIMEOUT;

        if (cmd_cb.proc_rsp) {
            cmd_cb.proc_rsp(p_rsp, sizeof(p_rsp));
        }

        event.op_code = cmd.op_code;
        event.p_data = p_rsp;
        event.length = sizeof(p_rsp);
        event.timeout = true;

        m_event_cb(&event);
    }
    else {
        // Should not come here
        LOG_ERR("op is unregisterd(wait rsp)");
    }

    state_set(&m_cmd_ctx, CMD_STATE_IDLE);
}

/**@brief Handler for processing request */
static void wk_proc_req_handler(struct k_work* unused)
{
    LOG_DBG("%s", __func__);

    int err_code;
    app_cmd_t cmd;
    cmd_cb_t  cmd_cb;
    cmd_event_t event;

    err_code = buff_to_cmd(&m_rx_buff, &cmd);
    if (err_code != 0) {
        LOG_ERR("Buffer error");
        return;
    }

    err_code = cmd_cb_get(cmd.op_code, &cmd_cb);
    if (err_code == 0) {
        if (cmd_cb.proc_req) {
            cmd_cb.proc_req(cmd.p_data, cmd.length, app_cmd_respond);
        }
        else {
            app_cmd_respond(NULL, 0);
        }

        event.op_code = cmd.op_code;
        event.p_data = cmd.p_data;
        event.length = cmd.length;
        event.timeout = false;

        m_event_cb(&event);
    }
    else {
        LOG_ERR("op is unregisterd(proc req)");
        uint8_t p_rsp[] = CMD_RSP_UNREG;

        app_cmd_respond(p_rsp, sizeof(p_rsp));
    }
}

/**@brief Handler for processing response */
static void wk_proc_rsp_handler(struct k_work* unused)
{
    LOG_DBG("%s", __func__);

    int err_code;
    app_cmd_t cmd;
    cmd_cb_t  cmd_cb;
    cmd_event_t event;

    state_set(&m_cmd_ctx, CMD_STATE_IDLE);

    err_code = buff_to_cmd(&m_rx_buff, &cmd);
    if (err_code != 0) {
        LOG_ERR("Buffer error");
        return;
    }

    err_code = cmd_cb_get(cmd.op_code, &cmd_cb);
    if (err_code == 0) {
        if (cmd_cb.proc_rsp) {
            cmd_cb.proc_rsp(cmd.p_data, cmd.length);
        }

        event.op_code = cmd.op_code;
        event.p_data = cmd.p_data;
        event.length = cmd.length;
        event.timeout = false;

        m_event_cb(&event);
    }
    else {
        // Should not come here
        LOG_ERR("op is unregisterd(proc rsp): %d", cmd.op_code);
    }
}

/**@brief Get cmd length from cmd data buffer
 *
 * @param[in] p_buff: pointer of cmd data buffer
 *
 * @return 0: not found
 *         others: cmd length
 */
static uint16_t cmd_len_get(buffer_t* p_buff)
{
    uint8_t* p_data;
    uint16_t cmd_len;

    cmd_len = 0;
    p_data = p_buff->p_data;
    if (p_buff->length == CMD_FMT_SIZE_START + CMD_FMT_SIZE_LEN) {
        cmd_len = CMD_FMT_OFFSET_OPCODE + CMD_FMT_SIZE_CRC +
            uint16_decode(&p_data[CMD_FMT_OFFSET_LEN]);
    }

    return cmd_len;
}

/**@brief Validate format of a cmd
 *
 * @param[in] p_buff: pointer of cmd data buffer
 * @param[in] op_code: op code of the request in host mode,
 *  in slave mode, it's not used
 *
 * @return 0: format is ok
 *         -1: format is wrong
 */
static int format_check(buffer_t* p_buff, uint8_t op_code, cmd_mode_t mode)
{
    uint16_t cmd_len;
    uint16_t cmd_crc;
    bool crc_ok;

    uint8_t* p_data = p_buff->p_data;
    uint16_t length = p_buff->length;

    // Check start flag
    if (mode == CMD_MODE_HOST &&
        p_data[CMD_FMT_OFFSET_START] != CMD_FMT_START_RSP) {
        LOG_ERR("Invalid cmd format: start(host)");
        return -1;
    }
    else if (mode == CMD_MODE_SLAVE &&
        p_data[CMD_FMT_OFFSET_START] != CMD_FMT_START_REQ) {
        LOG_ERR("Invalid cmd format: start(slave)");
        return -1;
    }

    // Check length
    cmd_len = uint16_decode(&p_data[CMD_FMT_OFFSET_LEN]) +
        CMD_FMT_OFFSET_OPCODE + CMD_FMT_SIZE_CRC;
    if (length != cmd_len) {
        LOG_ERR("Invalid cmd format: length");
        return -1;
    }

    // Check op code
    if (mode == CMD_MODE_HOST &&
        p_data[CMD_FMT_OFFSET_OPCODE] != op_code) {
        LOG_ERR("Invalid cmd format: op code");
        return -1;
    }

    // Check CRC
    cmd_crc = uint16_decode(&p_data[cmd_len - CMD_FMT_SIZE_CRC]);
    crc_ok = crc16_check(&p_data[CMD_FMT_OFFSET_LEN],
        cmd_len - CMD_FMT_SIZE_START - CMD_FMT_SIZE_CRC,
        cmd_crc);
    if (!crc_ok) {
        LOG_ERR("Invalid cmd format: crc");
        return -1;
    }

    return 0;
}
/**@brief Get op code from a cmd data buffer */
static int op_code_get(buffer_t* p_buff, uint8_t* op_code)
{
    if (p_buff == NULL || p_buff->p_data == NULL) {
        return -1;
    }

    // Assume it's a valid buffer, so skip format check
    *op_code = p_buff->p_data[CMD_FMT_OFFSET_OPCODE];

    return 0;
}

/**@brief Build a data buffer from a cmd structure
 *
 * @note It will allocate memory for buffer
 *
 * @param[in] p_cmd: pointer of cmd
 * @param[out] p_buff: cmd data buffer
 *
 * @return 0: ok
 */
static int cmd_to_buff(app_cmd_t* p_cmd, buffer_t* p_buff)
{
    __ASSERT_NO_MSG(p_cmd != NULL);

    uint16_t crc16;
    uint16_t pdu_len;
    uint8_t* p_packet;
    uint16_t pkt_len;

    buff_alloc(m_tx_pool, p_buff);

    p_packet = p_buff->p_data;
    pdu_len = p_cmd->length;

    /* Start flag */
    p_packet[CMD_FMT_OFFSET_START] =
        (p_cmd->type == CMD_TYPE_RESPONSE) ?
        CMD_FMT_START_RSP :
        CMD_FMT_START_REQ;

    /* Length */
    uint16_encode(CMD_FMT_SIZE_OPCODE + pdu_len,
        &p_packet[CMD_FMT_OFFSET_LEN]);

    /* OP code */
    p_packet[CMD_FMT_OFFSET_OPCODE] = p_cmd->op_code;

    /* PDU */
    if (pdu_len > 0 && p_cmd->p_data != NULL) {
        memcpy(&p_packet[CMD_FMT_OFFSET_PDU], p_cmd->p_data, pdu_len);
    }

    /* CRC: crc16 init value must be 0 */
    crc16 = crc16_compute(&p_packet[CMD_FMT_OFFSET_LEN],
        CMD_FMT_SIZE_LEN + CMD_FMT_SIZE_OPCODE + pdu_len);
    uint16_encode(crc16, &p_packet[CMD_FMT_OFFSET_PDU + pdu_len]);

    /* Packet length */
    pkt_len = CMD_FMT_OFFSET_PDU + pdu_len + CMD_FMT_SIZE_CRC;
    pkt_len = MIN(pkt_len, CMD_PACKET_LENGTH);

    p_buff->length = pkt_len;

    return 0;
}

/**@brief Get a cmd from a data buff 
 * 
 * @param[in] p_buff: cmd data buffer
 * @param[out] p_cmd: pointer of cmd
 *
 * @return 0: ok
 *         -1: pointer is NULL
 */
static int buff_to_cmd(buffer_t* p_buff, app_cmd_t* p_cmd)
{
    if (p_buff->p_data == NULL || p_cmd == NULL) {
        return -1;
    }

    uint8_t* p_data;
    uint16_t op_pdu_len;

    p_data = p_buff->p_data;
    op_pdu_len = uint16_decode(&p_data[CMD_FMT_OFFSET_LEN]);

    p_cmd->type = p_data[CMD_FMT_OFFSET_START];
    p_cmd->op_code = p_data[CMD_FMT_OFFSET_OPCODE];
    p_cmd->length = op_pdu_len - CMD_FMT_SIZE_OPCODE;
    p_cmd->p_data = &p_data[CMD_FMT_OFFSET_PDU];

    return 0;
}

/**@brief Send a cmd by UART */
static int cmd_send(app_cmd_t* p_cmd)
{
    on_cmd_send_start();

    cmd_to_buff(p_cmd, &m_tx_buff);
    return app_uart_send(m_tx_buff.p_data, m_tx_buff.length);
}

/**@brief Send a response */
static int app_cmd_respond(uint8_t* p_data, uint16_t length)
{
    int err_code;
    uint8_t  op_code;
    app_cmd_t cmd;

    if (state_get(&m_cmd_ctx) != CMD_STATE_REQ_RECEIVED &&
        state_get(&m_cmd_ctx) != CMD_STATE_REQ_SENT) {
        LOG_ERR("Invalid state for response:%d", state_get(&m_cmd_ctx));
        return -1;
    }

    err_code = op_code_get(&m_rx_buff, &op_code);
    if (err_code != 0) {
        LOG_ERR("rx buffer is reset too early");
        on_cmd_send_error();
        return err_code;
    }

    cmd.type = CMD_TYPE_RESPONSE;
    cmd.op_code = op_code;
    cmd.p_data = p_data;
    cmd.length = length;

    return cmd_send(&cmd);
}

/**@brief Send a request cmd
 *
 * @param[in] op_code: cmd op code
 * @param[in] p_data: pointer of cmd data
 * @param[in] length: length of cmd data
 *
 * @return 0: success
 * @return -1: error
 */
uint32_t app_cmd_request(uint8_t op_code, uint8_t* p_data, uint16_t length)
{
    if (mode_get(&m_cmd_ctx) != CMD_MODE_IDLE) {
        return -1;
    }

    app_cmd_t cmd =
    {
        .type = CMD_TYPE_REQUEST,
        .op_code = op_code,
        .p_data = p_data,
        .length = length,
    };

    mode_set(&m_cmd_ctx, CMD_MODE_HOST);

    return cmd_send(&cmd);
}

/**@brief Register a callback for request and response
 *
 * @note This functions is duplicated to callback functions
 * (req_proc, rsp_proc), but it's useful 
 *
 * @todo Check to remove rsp_proc
 */
void app_cmd_event_cb_register(cmd_event_cb_t event_cb)
{
    if (event_cb != NULL) {
        m_event_cb = event_cb;
    }
}

/**@brief Handler for UART tx complete */
static void on_uart_tx_empty(int event)
{
    LOG_DBG("%s", __func__);
    if (event == 0) {
        on_cmd_send_complete();
    }
    else {
        on_cmd_send_error();
    }
}

/**@brief Handler for UART rx data ready */
static void on_uart_rx_ready(uint8_t* p_data, uint16_t length)
{
    int err_code;
    uint8_t  req_op_code;
    static bool rx_started;
    static uint16_t cmd_len;

    if (mode_get(&m_cmd_ctx) == CMD_MODE_HOST) {
        if (m_cmd_ctx.state != CMD_STATE_REQ_SENT &&
            m_cmd_ctx.state != CMD_STATE_RSP_RECEIVING) {
            LOG_WRN("Invalid state for rx(host)");
            return;
        }
    }

    if (mode_get(&m_cmd_ctx) == CMD_MODE_SLAVE) {
        if (m_cmd_ctx.state != CMD_STATE_REQ_RECEIVING) {
            LOG_WRN("Invalid state for rx(slave)");
            return;
        }
    }

    if (!rx_started) {
        rx_started = true;
        buff_alloc(m_rx_pool, &m_rx_buff);
        cmd_len = 0;
        on_cmd_receive_start();
    }

    m_rx_buff.length = length;

    if (cmd_len == 0) {

        cmd_len = cmd_len_get(&m_rx_buff);

        if (cmd_len > CMD_PACKET_LENGTH) {
            on_cmd_receive_error();
        }

        if (cmd_len == 0) {
            return;
        }
    }

    if (m_rx_buff.length < cmd_len) {
        return;
    }

    LOG_HEXDUMP_DBG(m_rx_buff.p_data, m_rx_buff.length, "RX");

    req_op_code = 0;
    if (mode_get(&m_cmd_ctx) == CMD_MODE_HOST) {
        op_code_get(&m_tx_buff, &req_op_code);
    }
    err_code = format_check(&m_rx_buff, req_op_code, mode_get(&m_cmd_ctx));

    if (err_code == 0) {
        on_cmd_receive_complete();
    }
    // Invalid format
    else if (err_code == -1) {
        on_cmd_receive_error();
    }
    // On going receiving
    else {
        LOG_ERR("Should not come here(%d)", err_code);
        on_cmd_receive_error();
    }

    rx_started = false;
}

/**@brief Initialize app cmd module
 *
 * @param[in] p_device: pointer of UART device
 * @param[in] evt_cb: callback of cmd event
 *
 * @return 0: success
 * @return neg: error
 */
int app_cmd_init(struct device* p_device)
{
    int rc;
    static bool initialized = false;

    rc = app_uart_init(p_device, m_rx_pool, CMD_PACKET_LENGTH);
    if (rc != 0) {
        LOG_ERR("UART device init failed");
        return -ENXIO;
    }

    state_set(&m_cmd_ctx, CMD_STATE_IDLE);

    memset(&m_cmd_ctx.cmd, 0, sizeof(app_cmd_t));

    memset(&m_rx_pool, 0, sizeof(m_rx_pool));
    memset(&m_tx_pool, 0, sizeof(m_tx_pool));
    memset(&m_rx_buff, 0, sizeof(buffer_t));
    memset(&m_tx_buff, 0, sizeof(buffer_t));

    app_uart_rx_cb_set(on_uart_rx_ready);
    app_uart_tx_cb_set(on_uart_tx_empty);

    if (!initialized) {
        initialized = true;

        m_event_cb = event_cb_dummy;

        memset(&m_cb_list, 0, sizeof(m_cb_list));

        k_work_init(&wk_proc_req, wk_proc_req_handler);
        k_work_init(&wk_proc_rsp, wk_proc_rsp_handler);

        app_cmd_add(CMD_OP_PING, req_cb_ping, rsp_cb_ping);
        app_cmd_add(CMD_OP_RAW_DATA, req_cb_raw_data, rsp_cb_raw_data);
    }

    return 0;
}

/**@brief Un-initialize app cmd module */
void app_cmd_uninit(void)
{
    app_uart_uninit();

    k_timer_stop(&tmr_wait_rsp);
}

/**@brief Callback function for ping request. */
static int req_cb_ping(uint8_t* p_req, uint16_t req_len, cmd_respond_t respond)
{
    LOG_INF("%s", __func__);

    char* rsp = "ok";
    respond(rsp, strlen(rsp));

    return 0;
}

/**@brief Callback function for ping response. */
static void rsp_cb_ping(uint8_t* p_rsp, uint16_t rsp_len)
{
    LOG_INF("%s", __func__);
}

/**@brief Callback function for raw_data request. */
static int req_cb_raw_data(uint8_t* p_req, uint16_t req_len, cmd_respond_t respond)
{
    LOG_DBG("%s", __func__);
    char* rsp = "ok";

    // TODO: fill user function to handle raw data
    if (req_len > 0) {
        LOG_HEXDUMP_INF(p_req, MIN(req_len, 8), "raw data:");
    }

    respond(rsp, strlen(rsp));

    return 0;
}

/**@brief Callback function for mtu_get response. */
static void rsp_cb_raw_data(uint8_t* p_rsp, uint16_t rsp_len)
{
    LOG_DBG("%s", __func__);

    if (rsp_len > 0) {
        LOG_HEXDUMP_INF(p_rsp, MIN(rsp_len, 8), "raw data:");
    }
}

/**@brief Send a ping request */
void cmd_request_ping(void)
{
    app_cmd_request(CMD_OP_PING, "yq", 2);
}

/**@brief Send a raw data request */
void cmd_request_raw_data(uint8_t* p_data, uint16_t length)
{
    app_cmd_request(CMD_OP_RAW_DATA, p_data, length);
}
```

## src/app_cmd.h
```c
#ifndef APP_CMD_H__
#define APP_CMD_H__

#include <stdint.h>
#include <zephyr.h>
#include <device.h>

#ifdef __cplusplus
extern "C" {
#endif

/******************************************************************
    cmd format:

    -------------------------------------------------------------
        Field     |  Start  |  Length  |  OPCODE  |  PDU  |  CRC  |
    -------------------------------------------------------------
        Len(byte) |    1    |    2     |    1     | >= 0  |   2   |
    -------------------------------------------------------------

    Length = len(OPCODE + PDU)
    CRC = crc16(Length + OPCODE + PDU)

    All use little endian

*******************************************************************/
#define CMD_TYPE_REQUEST          0
#define CMD_TYPE_RESPONSE         1

#define CMD_FMT_START_REQ         0x59
#define CMD_FMT_START_RSP         0x51

#define CMD_FMT_SIZE_START        1
#define CMD_FMT_SIZE_LEN          2
#define CMD_FMT_SIZE_OPCODE       1
#define CMD_FMT_SIZE_CRC          2

#define CMD_FMT_OFFSET_START      0
#define CMD_FMT_OFFSET_LEN        1
#define CMD_FMT_OFFSET_OPCODE     3
#define CMD_FMT_OFFSET_PDU        4

// Internal commands: 0x10 - 0x1F
#define CMD_OP_INTERNAL     0x10
#define CMD_OP_PING         (CMD_OP_INTERNAL + 1)
#define CMD_OP_RAW_DATA     (CMD_OP_INTERNAL + 2)

/* Response data for ok */
#define CMD_RSP_OK          { 'o', 'k' }
/* Response data for timeout */
#define CMD_RSP_TIMEOUT     { 't', 'o' }
/* Response data for un-registered */
#define CMD_RSP_UNREG       { 'u', 'r' }


/**@typedef cmd work mode */
typedef enum
{
    CMD_MODE_IDLE,              /* Idle */
    CMD_MODE_HOST,              /* Send request and wait for response */
    CMD_MODE_SLAVE,             /* Receive request and return response */
} cmd_mode_t;

/**@typedef cmd work state */
typedef enum
{
    CMD_STATE_IDLE,             /* Idle */
    CMD_STATE_REQ_SENDING,      /* The request is being sent */
    CMD_STATE_REQ_SENT,         /* The request is sent */
    CMD_STATE_REQ_RECEIVING,    /* The request is being received */
    CMD_STATE_REQ_RECEIVED,     /* The request is received */
    CMD_STATE_RSP_SENDING,      /* The response is being sent */
    CMD_STATE_RSP_SENT,         /* The response is sent */
    CMD_STATE_RSP_RECEIVING,    /* The response is being receiving */
    CMD_STATE_RSP_RECEIVED,     /* Thre response is received */
    CMD_STATE_ERR_TIMEOUT,      /* Error for waiting response timeout */
    CMD_STATE_ERR_SEND,         /* Error for UART sending */
    CMD_STATE_ERR_RECEIVE,      /* Error for UART receiving */
} cmd_state_t;

/**@typedef sending respond callback type
 *
 * @param[in] p_data: pointer of data
 * @param[in] length: data length
 *
 * @return 0: success
 * @return neg: error
 */
typedef int (*cmd_respond_t)(uint8_t* p_data, uint16_t len);

/**@typedef process request callback function
 *
 * @param[in] p_req: pointer of request data
 * @param[in] req_len: request data length
 * @param[in] respond: sending response callback function
 *
 * @return 0: success
 * @return neg: error
 */
typedef int (*req_cb_t)(uint8_t* p_req, uint16_t req_len, cmd_respond_t respond);

/**@typedef process response callback function
 *
 * @param[in] p_rsp: pointer of response data
 * @param[in] rsp_len: response data length
 *
 * @return n/a
 */
typedef void (*rsp_cb_t)(uint8_t* p_rsp, uint16_t rsp_len);

/**@typedef app cmd callback */
typedef struct
{
    uint8_t     op_code;
    req_cb_t    proc_req;       /* request processing callback */
    rsp_cb_t    proc_rsp;       /* response processing callback */
} cmd_cb_t;

/**@typedef app cmd */
typedef struct
{
    uint8_t     type;           /* request or response */
    uint8_t     op_code;        /* op code */
    uint8_t*    p_data;         /* PDU data */
    uint16_t    length;         /* PDU data length */
} app_cmd_t;

/**@typedef app cmd context */
typedef struct
{
    cmd_mode_t   mode;
    cmd_state_t  state;
    app_cmd_t    cmd;
} cmd_context_t;

/**@typedef app cmd event */
typedef struct
{
    uint8_t  op_code;
    uint8_t* p_data;
    uint16_t length;
    bool     timeout;
} cmd_event_t;

/**@brief cmd event callback */
typedef void (*cmd_event_cb_t)(cmd_event_t* p_event);

/**@brief Initialize app_cmd module.
 *
 * @param[in] p_device: pointer of uart device.
 */
int app_cmd_init(struct device* p_device);

/**@brief Un-initialize app cmd module */
void app_cmd_uninit(void);

/**@brief Register response processing callback */
void app_cmd_event_cb_register(cmd_event_cb_t cb);

/**@brief Send a request cmd
 *
 * @param[in] op_code: cmd op code
 * @param[in] p_data: pointer of cmd data
 * @param[in] length: length of cmd data
 *
 * @return 0: success
 * @return -1: error
 */
uint32_t app_cmd_request(uint8_t op_code, uint8_t* p_data, uint16_t length);

/**@brief Add a cmd to the list
 *
 * @param[in] op_code: op code of cmd
 * @param[in] req_cb: request callback function
 * @param[in] rsp_cb: response callback function
 *
 * @return 0: success
 * @return -1: cmd list is full
 * @return -2: op code is existed
 * @return -2: op code is not added, use app_cmd_add to add it
 */
int app_cmd_add(uint8_t op_code, req_cb_t req_cb, rsp_cb_t rsp_cb);

/*@brief Send a ping request */
void cmd_request_ping(void);

/*@brief Send a raw data request */
void cmd_request_raw_data(uint8_t* p_data, uint16_t length);


#ifdef __cplusplus
}
#endif

#endif /* APP_CMD_H__ */
```

## src/app_flash.c
```c
#include <zephyr.h>
#include <device.h>
#include <drivers/flash.h>
#include <storage/flash_map.h>
#include <sys/crc.h>
#include <sys/byteorder.h>
#include <sys/util.h>
#include <logging/log.h>
LOG_MODULE_REGISTER(app_flash, 3);

#include "app_flash.h"

/**@brief Get flash info
 *
 * @details Info structure: bank start address[4], page
 * count of the bank[4], the first blank page[4].
 * The first blank page is used to implement resume
 * from the break point.
 *
 * @return 0: success
 * @return neg: error
 */
int app_flash_info(u8_t* p_data)
{
	int rc;
	const struct flash_area* fa;
	u32_t bank_addr;
	u32_t page_count;
	u32_t first_blank;

	u32_t p_read;
	bool  found;

	rc = flash_area_open(APP_FLASH_BANK_ID, &fa);
	if (rc) {
		return rc;
	}

	bank_addr = fa->fa_off;
	page_count = fa->fa_size / 0x1000;

	flash_area_close(fa);

	found = false;
	p_read = bank_addr;
	while (p_read < fa->fa_size) {
		for (u32_t i = 0; i < 4096; i++) {
			if (((u8_t*)p_read)[i] != 0xFF) {
				found = true;
				break;
			}
		}

		if (!found) {
			break;
		}

		p_read += 4096;
	}

	first_blank = MAX(bank_addr, (p_read - 4096));

	sys_put_le32(bank_addr, &p_data[0]);
	sys_put_le32(page_count, &p_data[4]);
	sys_put_le32(first_blank, &p_data[8]);

	return rc;
}

/**@brief Read flash data
 *
 * @param[in] offset: offset from the bank start
 * @param[out] p_data: pointer of data
 * @param[in] length: length of data to be read
 *
 * @return 0: success
 * @return neg: error
 */
int app_flash_read(u32_t offset, u8_t* p_data, u32_t length)
{
	int rc;
	const struct flash_area* fa;

	rc = flash_area_open(APP_FLASH_BANK_ID, &fa);
	if (rc) {
		return rc;
	}

    // TODO: here should check the boundary of flash

	rc = flash_area_read(fa, offset, p_data, length);
	if (rc) {
		return rc;
	}

	flash_area_close(fa);

	return rc;
}

/**@brief Write flash data
 *
 * @details If length is not word aligned, it will fill
 * 0xFF as end padding
 *
 * @param[in] offset: offset from the bank start
 * @param[in] p_data: pointer of data
 * @param[in] length: length of data to be read
 *
 * @return 0: success
 * @return neg: error
 */
int app_flash_write(u32_t offset, u8_t* p_data, u32_t length)
{
	int rc;
	const struct flash_area* fa;
	u8_t  p_last_word[4] = {0xFF, 0xFF, 0xFF, 0xFF};
	u32_t word_align_len;

	rc = flash_area_open(APP_FLASH_BANK_ID, &fa);
	if (rc) {
		return rc;
	}

	if (length % 4 != 0) {
		word_align_len = length / 4 * 4;
	}
	else {
		word_align_len = length;
	}

	rc = flash_area_write(fa, offset, p_data, word_align_len);
	if (rc != 0) {
		return rc;
	}

	if (word_align_len < length) {
		memcpy(p_last_word, &p_data[word_align_len], (length - word_align_len));
		rc = flash_area_write(fa, offset + word_align_len, p_last_word, 4);
		if (rc) {
			return rc;
		}
	}

	flash_area_close(fa);

	return rc;
}

/**@brief Erase flash pages
 *
 * @param[in] offset: offset from the bank start
 * @param[in] count: page count to be erased
 *
 * @return 0: success
 * @return neg: error
 */
int app_flash_erase_page(u32_t offset, u32_t count)
{
	int rc;
	const struct flash_area* fa;
	u32_t byte_len;

	rc = flash_area_open(APP_FLASH_BANK_ID, &fa);
	if (rc) {
		return rc;
	}

	byte_len = MIN(count * 0x1000, fa->fa_size);

	rc = flash_area_erase(fa, offset, byte_len);

	flash_area_close(fa);

	return rc;
}

/**@brief Erase flash pages from the bank end
 *
 * @param[in] offset: offset from the bank start
 * @param[in] count: page count to be erased
 *
 * @return 0: success
 * @return neg: error
 */
int app_flash_erase_from_end(u32_t count)
{
	int rc;
	const struct flash_area* fa;
	u32_t byte_len;
    u32_t offset;

	rc = flash_area_open(APP_FLASH_BANK_ID, &fa);
	if (rc) {
		return rc;
	}

	byte_len = MIN(count * 0x1000, fa->fa_size);
    offset = fa->fa_size - byte_len;

	rc = flash_area_erase(fa, offset, byte_len);

	flash_area_close(fa);

	return rc;
}

/**@brief Get crc value of flash data
 *
 * @param[in] offset: offset from the bank start
 * @param[in] length: length of data to be read
 * @param[out] crc32: pointer of crc value
 *
 * @return 0: success
 * @return neg: error
 */
int app_flash_crc(u32_t offset, u32_t length, u32_t* crc32)
{
	int rc;
	const struct flash_area* fa;
	u8_t *bank_addr;
	u32_t step = 1024;
	u32_t crc_val = 0;
	u32_t i;

	rc = flash_area_open(APP_FLASH_BANK_ID, &fa);
	if (rc) {
		return rc;
	}

	bank_addr = (u8_t *)(fa->fa_off);

	if (length <= step) {
		crc_val = crc32_ieee(bank_addr, length);
	}
	else {
		crc_val = 0;

		for (i = 0; i < length / step; i++) {
			crc_val = crc32_ieee_update(crc_val, bank_addr + i * step, step);
		}
		if (length % step != 0) {
			crc_val = crc32_ieee_update(crc_val, bank_addr + i * step, length % step);
		}
	}
	*crc32 = crc_val;

	flash_area_close(fa);

	return rc;
}
```

## src/app_flash.h
```c
#ifndef APP_FLASH_H__
#define APP_FLASH_H__

#include <zephyr.h>

#ifdef __cplusplus
extern "C" {
#endif

#ifdef PM_MCUBOOT_SECONDARY_ID
#define APP_FLASH_BANK_ID			PM_MCUBOOT_SECONDARY_ID
#else
#define APP_FLASH_BANK_ID			FLASH_AREA_ID(image_1)		// 3: flash0 -> "image-1"
#endif // PM_MCUBOOT_SECONDARY_ID

int app_flash_info(u8_t* p_data);
int app_flash_read(u32_t offset, u8_t* p_data, u32_t length);
int app_flash_write(u32_t offset, u8_t* p_data, u32_t length);
int app_flash_erase_page(u32_t offset, u32_t count);
int app_flash_erase_from_end(u32_t count);
int app_flash_crc(u32_t offset, u32_t length, u32_t* crc32);

#ifdef __cplusplus
}
#endif

#endif /* APP_FLASH_H__ */
```

## src/app_flash_cmd.h
```c
#ifndef APP_FLASH_CMD_H__
#define APP_FLASH_CMD_H__

#include <zephyr.h>
#include "app_cmd.h"

#ifdef __cplusplus
extern "C" {
#endif

// app flash commands: 0x20 - 0x2F
#define CMD_OP_FLASH        0x20
#define CMD_OP_FLASH_INFO   (CMD_OP_FLASH + 1)
#define CMD_OP_FLASH_READ   (CMD_OP_FLASH + 2)
#define CMD_OP_FLASH_WRITE  (CMD_OP_FLASH + 3)
#define CMD_OP_FLASH_ERASE  (CMD_OP_FLASH + 4)
#define CMD_OP_FLASH_CRC    (CMD_OP_FLASH + 5)
#define CMD_OP_FLASH_START  (CMD_OP_FLASH + 6)
#define CMD_OP_FLASH_DONE   (CMD_OP_FLASH + 7)

/**@brief Register flash related commands
 *
 * @param cb: event callback
 */
void app_flash_cmd_init(void);

#ifdef __cplusplus
}
#endif

#endif /* APP_FLASH_CMD_H__ */
```

## src/button.h
```c
#ifndef BUTTON_H__
#define BUTTON_H__

#include <zephyr.h>

#ifdef __cplusplus
extern "C" {
#endif

typedef void (*button_handler)(void);

/**@brief Initialize button module */
int button_init(void);

/**@brief Assign interrupt handler to a button
 *
 * @param[in] button_id: one of {"button_1", "button_2", "switch_1", "switch_2" }
 * @param[in] handler: interrupt handler of button
 *
 * @return 0: success
 * @return -1: error
 */
int button_handler_assign(char* button_id, button_handler handler);

/**@brief Read status of a button
 *
 * @param[in] button_id: one of {"button_1", "button_2", "switch_1", "switch_2" }
 *
 * @return 0: success
 * @return -1: error
 */
int button_read(char* button_id);

#ifdef __cplusplus
}
#endif

#endif /* BUTTON_H__ */
```

## src/http_client.h
```c
#ifndef HTTP_CLIENT_H__
#define HTTP_CLIENT_H__

#include <zephyr.h>
#include <net/fota_download.h>

#ifdef __cplusplus
extern "C" {
#endif

/**@brief Initialize http client module 
 * 
 * @param[in] download_client: fota download callback 
 *
 * @return 0: success
 * @return neg: error
 */
int http_client_init(fota_download_callback_t download_callback);

/**@brief Start to connect LTE network */
int http_client_connect(void);

/**@brief Start to HTTP download 
 *
 * @param[in] host: host name
 * @param[in] file: file path
 *
 * @return 0: success
 * @return neg: error
 */
int http_client_download(char* host, char* file);

#ifdef __cplusplus
}
#endif

#endif /* HTTP_CLIENT_H__ */
```
